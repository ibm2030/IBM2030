## petalinux/zynq_petalinux/project-spec/configs/configs/Kconfig
```kconfig
mainmenu "PetaLinux System Configuration"
config SUBSYSTEM_TYPE_LINUX
        bool
        default y
        select SYSTEM_ZYNQ

config SYSTEM_ZYNQ
        bool "ZYNQ Configuration"
        help
          ZYNQ Configuration for the project.
          All these config options will be in /mnt/LJW2025/Xilinx/petalinux/zynq_petalinux/project-spec/configs/config

config SUBSYSTEM_DISTRO_PETALINUX
        bool
        default y
        help

source /mnt/LJW2025/Xilinx/petalinux/zynq_petalinux/project-spec/configs/configs/Kconfig.main
```

## petalinux/zynq_petalinux/project-spec/configs/configs/Kconfig.main
```kconfig
# Copyright (C) 2021-2022, Xilinx, Inc.  All rights reserved.
# Copyright (C) 2022-2024, Advanced Micro Devices, Inc.  All rights reserved.
#
# SPDX-License-Identifier: MIT
#

choice
	prompt "Subsystem Architecture (NO EDIT!)"
	default SUBSYSTEM_ARCH_ARM
	help
	  This option is to control the processor targeted by System Configuration.
	  WARNING: Do not edit this option.

config SUBSYSTEM_ARCH_AARCH64
	bool "aarch64"
	help
	  Choose this option to specify AARCH64 as the SUBSYSTEM architecture

config SUBSYSTEM_ARCH_ARM
	bool "arm"
	help
	  Choose this option to specify ARM as the SUBSYSTEM architecture

config SUBSYSTEM_ARCH_MICROBLAZE
	bool "microblaze"
	help
	  Choose this option to specify MicroBlaze as the SUBSYSTEM architecture
endchoice

config SUBSYSTEM_ENDIAN_LITTLE
	bool
	default y

if SUBSYSTEM_SDT_FLOW

source /mnt/LJW2025/Xilinx/petalinux/zynq_petalinux/project-spec/configs/configs/Kconfig.bootcompselection

endif

if SUBSYSTEM_DISTRO_PETALINUX

source /mnt/LJW2025/Xilinx/petalinux/zynq_petalinux/project-spec/configs/configs/Kconfig.linuxcompselection

source /mnt/LJW2025/Xilinx/petalinux/zynq_petalinux/project-spec/configs/configs/Kconfig.autoconfigsettings

endif

source /mnt/LJW2025/Xilinx/petalinux/zynq_petalinux/project-spec/configs/configs/Kconfig.syshw

source /mnt/LJW2025/Xilinx/petalinux/zynq_petalinux/project-spec/configs/configs/Kconfig.dtgsettings

source /mnt/LJW2025/Xilinx/petalinux/zynq_petalinux/project-spec/configs/configs/Kconfig.bootcompconfigurations

if SUBSYSTEM_DISTRO_PETALINUX

source /mnt/LJW2025/Xilinx/petalinux/zynq_petalinux/project-spec/configs/configs/Kconfig.imagepkgconfigurations

endif

source /mnt/LJW2025/Xilinx/petalinux/zynq_petalinux/project-spec/configs/configs/Kconfig.yoctobuildsettings
```

## petalinux/zynq_petalinux/project-spec/configs/rootfsconfigs/Kconfig.user
```kconfig
menu "user packages " 
config axibram  
	 bool "axibram"
	 help
	
config gpio-demo  
	 bool "gpio-demo"
	 help
	
config ls-dump  
	 bool "ls-dump"
	 help
	
config ms-dump  
	 bool "ms-dump"
	 help
	
config peekpoke  
	 bool "peekpoke"
	 help
	
endmenu
```
